## MotorController/Manual Control/esp32_code/main/Kconfig.projbuild
```kconfig
menu "Echo Example Configuration"

    orsource "$IDF_PATH/examples/common_components/env_caps/$IDF_TARGET/Kconfig.env_caps"

    config EXAMPLE_TASK_STACK_SIZE
        int "UART echo example task stack size"
        range 1024 16384
        default 2048
        help
            Defines stack size for UART echo example. Insufficient stack size can cause crash.

endmenu
```

## MotorController/udp_server/main/Kconfig.projbuild
```kconfig
menu "Example Configuration"

    config EXAMPLE_IPV4
        bool "IPV4"
        default y

    config EXAMPLE_IPV6
        bool "IPV6"
        default n
        select EXAMPLE_CONNECT_IPV6

    config EXAMPLE_PORT
        int "Port"
        range 0 65535
        default 3333
        help
            Local port the example server will listen on.
    config EXAMPLE_SERVER_IP
        string "Server IP"
        default "10.0.0.1"
    config EXAMPLE_SERVER_PORT
        int "Server Port"
        range 0 65535
        default 3333
        help
            Local port the example server will listen on.

endmenu
```
